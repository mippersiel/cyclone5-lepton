## distro/meta-cyclone5-lepton/conf/distro/cyclone5-lepton.conf
```bitbake
require conf/distro/poky.conf

# Disto
DISTRO = "cyclone5-lepton"
DISTRO_NAME = "Cyclone5 Lepton"
DISTRO_VERSION = "0.1"
MAINTAINER = "Matthieu Ippersiel"

DISTRO_FEATURES += " pam"
DISTRO_FEATURES_remove = "x11 directfb wayland"


# SDK
SDK_VENDOR = "-mid"
SDK_NAME = "${DISTRO}-${SDK_ARCH}-${TUNE_PKGARCH}"
SDK_VERSION = "${DISTRO_VERSION}"
SDK_PATH = "/usr/local/sdk-${MACHINE}-${DISTRO}-${SDK_VERSION}"
SDKPATH = "${SDK_PATH}"

# Have kernel headers in SDK
TOOLCHAIN_TARGET_TASK_append = " kernel-devsrc"

TARGET_OS = "linux-gnueabi"
TARGET_VENDOR = "-mid"
```

## distro/meta-cyclone5-lepton/conf/distro/include/cyclone5-lepton-image-base.inc
```bitbake
# Cyclone5 lepton base distro configurations/definitions.

# copy the license.manifest to the image
COPY_LIC_MANIFEST = "1"
```

## distro/meta-cyclone5-lepton/conf/layer.conf
```bitbake
# We have a packages directory, add to BBFILES
BBPATH := "${BBPATH}:${LAYERDIR}"

BBFILES += "${LAYERDIR}/recipes-*/*/*.bb*"
BBFILES += "${LAYERDIR}/images/*.bb*"
BBFILES += "${LAYERDIR}/classes/*.bb*"

BBFILE_COLLECTIONS += "meta-cyclone5-lepton"
BBFILE_PATTERN_meta-cyclone5-lepton := "^${LAYERDIR}/"
BBFILE_PRIORITY_meta-cyclone5-lepton = "9"
LAYERSERIES_COMPAT_meta-cyclone5-lepton = "dunfell"

# Let us add layer-specific bbappends which are only applied when that
# layer is included in our configuration
BBFILES += "${@' '.join('${LAYERDIR}/recipes*/%s/*/*.bbappend' % layer \
              for layer in BBFILE_COLLECTIONS.split())}"


# Let us add layer-specific bb which are only applied when that
# layer is included in our configuration
BBFILES += "${@' '.join('${LAYERDIR}/recipes*/%s/*/*.bb' % layer \
              for layer in BBFILE_COLLECTIONS.split())}"
```

## distro/meta-cyclone5-lepton/conf/machine/lepton-de0-nano.conf
```bitbake
#@TYPE: Machine
#@NAME: lepton-de0-nano
#@DESCRIPTION: Machine configuration for the Cyclone V SoC"

# NOTE: Machine based on 'cyclone5' machine from meta-altera

require conf/machine/include/socfpga.inc

DEFAULTTUNE = "cortexa9hf-neon"

UBOOT_CONFIG = "de0-nano-soc"
UBOOT_CONFIG[de0-nano-soc] = "socfpga_de0_nano_soc_defconfig"

KMACHINE = "cyclone5"

# Kernel config
PREFERRED_PROVIDER_virtual/kernel = "linux-altera"
PREFERRED_VERSION_linux-altera = "5.5+gitAUTOINC+d5aa6a79dc"
KERNEL_DEVICETREE ?= " socfpga_cyclone5_de0_nano_soc.dtb \
                     "

SERIAL_CONSOLES ?= "115200;ttyS0"

# U-Boot config
PREFERRED_PROVIDER_u-boot = "u-boot"
PREFERRED_VERSION_u-boot = "v2019.10+gitAUTOINC+72bbbc5eee"
UBOOT_EXTLINUX ?= "1"
UBOOT_EXTLINUX_LABELS ?= "default"
UBOOT_EXTLINUX_DEFAULT_LABEL ?= "Lepton-de0-nano SDMMC"

UBOOT_EXTLINUX_FDT_default = "../socfpga_cyclone5_de0_nano_soc.dtb"
UBOOT_EXTLINUX_ROOT_default ?= "root=/dev/mmcblk0p3"
UBOOT_EXTLINUX_MENU_DESCRIPTION_default ?= "Lepton-de0-nano SDMMC"
UBOOT_EXTLINUX_KERNEL_IMAGE_default ?= "../${KERNEL_IMAGETYPE}"
UBOOT_EXTLINUX_FDTDIR_default ?= "../"
UBOOT_EXTLINUX_KERNEL_ARGS_default ?= "rootwait rw earlycon"

IMAGE_BOOT_FILES ?= " ${KERNEL_DEVICETREE} \
                      ${KERNEL_IMAGETYPE} \
                      extlinux.conf;extlinux/extlinux.conf \
                    "

EXTRA_IMAGECMD_jffs2 ?= "-e 0x10000"

WKS_FILE ?= "sdimage-cyclone5-arria5.wks"
IMAGE_FSTYPES +="wic"

# DE0 has no hardware clock
MACHINE_FEATURES_BACKFILL_CONSIDERED = "rtc"
```
